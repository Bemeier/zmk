## app/boards/arm/schiffre_nrf/Kconfig.board
```kconfig
# nrfmicro board configuration

# Copyright (c) 2020 The ZMK Contributors
# SPDX-License-Identifier: MIT

config BOARD_SCHIFFRE_NRF
	bool "schiffre_nrf"
	depends on SOC_NRF52840_QIAA
```

## app/boards/arm/schiffre_nrf/Kconfig.defconfig
```kconfig
# Electronut Labs Papyr board configuration

# Copyright (c) 2020 The ZMK Contributors
# SPDX-License-Identifier: MIT

if BOARD_SCHIFFRE_NRF

config BOARD
	default "schiffre_nrf"

if USB_DEVICE_STACK

config USB_NRFX
	default y

endif # USB_DEVICE_STACK

config BT_CTLR
	default BT

config ZMK_BLE
	default y

config ZMK_USB
	default y

config PINMUX
	default y

endif # BOARD_SCHIFFRE_NRF
```

## app/boards/shields/schiffre86/Kconfig.defconfig
```kconfig
# Copyright (c) 2020 The ZMK Contributors
# SPDX-License-Identifier: MIT

if SHIELD_SCHIFFRENRF

config ZMK_KEYBOARD_NAME
	default "schiffre86"

endif
```

## app/boards/shields/schiffre86/Kconfig.shield
```kconfig
# Copyright (c) 2020 The ZMK Contributors
# SPDX-License-Identifier: MIT

config SHIELD_SCHIFFRENRF
	def_bool $(shields_list_contains,schiffre86)
```
